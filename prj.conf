## CMakeLists.txt
```
cmake_minimum_required(VERSION 3.20.0)
find_package(Zephyr REQUIRED HINTS $ENV{ZEPHYR_BASE})
project(esp32_iot_framework)
target_include_directories(app PRIVATE include)
target_sources(app PRIVATE src/main.c src/config_store.c src/wifi_manager.c
  src/mqtt_service.c src/ota_service.c src/provisioning.c)
```

## Kconfig
```
mainmenu "ESP32-S3 IoT framework"
source "Kconfig.zephyr"

menu "IoT application"
config APP_WIFI_RETRY_SECONDS
    int "Delay between Wi-Fi connection attempts"
    range 1 300
    default 10
config APP_MQTT_PUBLISH_SECONDS
    int "Telemetry interval"
    range 1 3600
    default 30
endmenu
```

## west.yml
```
manifest:
  version: "0.13"
  projects:
    - name: zephyr
      url: https://github.com/zephyrproject-rtos/zephyr
      revision: v4.1.0
      import:
        name-allowlist:
          - cmsis
          - hal_espressif
          - mbedtls
          - mcuboot
          - zcbor
  self:
    path: esp32-iot-framework
```

## prj.conf
```kconfig
# ESP32-S3, IPv4 station with DHCP
CONFIG_WIFI=y
CONFIG_WIFI_ESP32=y
CONFIG_NET_L2_ETHERNET=y
CONFIG_NETWORKING=y
CONFIG_NET_IPV4=y
CONFIG_NET_IPV6=n
CONFIG_NET_DHCPV4=y
CONFIG_NET_TCP=y
CONFIG_NET_UDP=y
CONFIG_NET_SOCKETS=y
CONFIG_NET_MGMT=y
CONFIG_NET_MGMT_EVENT=y
CONFIG_NET_MGMT_EVENT_INFO=y
CONFIG_DNS_RESOLVER=y
CONFIG_MQTT_LIB=y
CONFIG_MQTT_KEEPALIVE=60
CONFIG_NET_MAX_CONTEXTS=10
CONFIG_NET_MAX_CONN=10
CONFIG_NET_PKT_RX_COUNT=16
CONFIG_NET_PKT_TX_COUNT=16
CONFIG_NET_BUF_RX_COUNT=64
CONFIG_NET_BUF_TX_COUNT=64

# Persistent application settings use the board storage_partition.
CONFIG_FLASH=y
CONFIG_FLASH_MAP=y
CONFIG_FLASH_PAGE_LAYOUT=y
CONFIG_NVS=y
CONFIG_SETTINGS=y
CONFIG_SETTINGS_NVS=y

CONFIG_LOG=y
CONFIG_LOG_DEFAULT_LEVEL=3
CONFIG_SERIAL=y
CONFIG_CONSOLE=y
CONFIG_UART_CONSOLE=y
CONFIG_SHELL=y
CONFIG_SHELL_STACK_SIZE=4096
CONFIG_REBOOT=y
CONFIG_MAIN_STACK_SIZE=4096
CONFIG_SYSTEM_WORKQUEUE_STACK_SIZE=2048
CONFIG_HEAP_MEM_POOL_SIZE=65536

# MCUboot image management. Network transport is opt-in (conf/ota-udp.conf).
CONFIG_BOOTLOADER_MCUBOOT=y
CONFIG_IMG_MANAGER=y
CONFIG_MCUBOOT_IMG_MANAGER=y
CONFIG_STREAM_FLASH=y
```

## app.overlay
```dts
/* Enable the on-chip station radio on the ESP32-S3 target. */
&wifi {
    status = "okay";
};
```

## src/main.c
```c
#include "config_store.h"
#include "wifi_manager.h"
#include "mqtt_service.h"
#include "ota_service.h"
#include <zephyr/logging/log.h>

LOG_MODULE_REGISTER(app);

int main(void)
{
    static struct app_config config;
    int err = ota_service_init();
    if (err) {
        LOG_ERR("OTA transport initialization failed: %d", err);
    }
    err = config_store_init();
    if (err) {
        LOG_ERR("Settings initialization failed: %d", err);
        return 0;
    }
    config_store_get(&config);
    if (!config.ssid[0]) {
        LOG_INF("Configure Wi-Fi with 'iot set', then reboot");
        return 0;
    }
    err = wifi_manager_init(config.ssid, config.password);
    if (err) {
        LOG_ERR("Wi-Fi initialization failed: %d", err);
        return 0;
    }
    if (config.broker[0]) {
        err = mqtt_service_start(&config);
        if (err) {
            LOG_ERR("MQTT initialization failed: %d", err);
        }
    }
    /* Test upgrades remain unconfirmed until an operator verifies health.
     * This preserves MCUboot rollback if networking or the application fails. */
    return 0;
}
```

## include/config_store.h
```c
#ifndef APP_CONFIG_STORE_H
#define APP_CONFIG_STORE_H
#include <stdint.h>

struct app_config {
    char ssid[33];
    char password[65];
    char broker[128];
    char client_id[48];
};
int config_store_init(void);
void config_store_get(struct app_config *out);
/* Persist one value; takes effect after reboot. No secret values are logged. */
int config_store_set(const char *key, const char *value);
#endif
```

## include/mqtt_service.h
```c
#ifndef MQTT_SERVICE_H
#define MQTT_SERVICE_H
#include "config_store.h"
int mqtt_service_start(const struct app_config *config);
#endif
```

## include/ota_service.h
```c
#ifndef OTA_SERVICE_H
#define OTA_SERVICE_H
int ota_service_init(void);
/* Call only after the application's health checks have passed. */
int ota_service_confirm(void);
#endif
```

## src/config_store.c
```c
#include "config_store.h"
#include <errno.h>
#include <string.h>
#include <stdio.h>
#include <zephyr/kernel.h>
#include <zephyr/settings/settings.h>
#include <zephyr/sys/util.h>

static struct app_config config = { .client_id = "esp32s3-iot" };
K_MUTEX_DEFINE(config_lock);

static char *field(const char *key, size_t *size)
{
    if (!key) {
        return NULL;
    }
    if (!strcmp(key, "ssid")) {
        *size = sizeof(config.ssid);
        return config.ssid;
    }
    if (!strcmp(key, "password")) {
        *size = sizeof(config.password);
        return config.password;
    }
    if (!strcmp(key, "broker")) {
        *size = sizeof(config.broker);
        return config.broker;
    }
    if (!strcmp(key, "client_id")) {
        *size = sizeof(config.client_id);
        return config.client_id;
    }
    return NULL;
}

static int load_setting(const char *key, size_t len,
                        settings_read_cb read_cb, void *cb_arg)
{
    char value[128] = {0};
    size_t capacity;
    char *dst = field(key, &capacity);
    if (!dst) {
        return -ENOENT;
    }
    if (len >= capacity) {
        return -EINVAL;
    }
    ssize_t read = read_cb(cb_arg, value, len);
    if (read < 0) {
        return (int)read;
    }
    if ((size_t)read != len || memchr(value, '\0', len)) {
        return -EINVAL;
    }
    k_mutex_lock(&config_lock, K_FOREVER);
    memset(dst, 0, capacity);
    memcpy(dst, value, len);
    k_mutex_unlock(&config_lock);
    return 0;
}
SETTINGS_STATIC_HANDLER_DEFINE(iot, "iot", NULL, load_setting, NULL, NULL);

int config_store_init(void)
{
    int err = settings_subsys_init();
    return err ? err : settings_load_subtree("iot");
}

void config_store_get(struct app_config *out)
{
    k_mutex_lock(&config_lock, K_FOREVER);
    *out = config;
    k_mutex_unlock(&config_lock);
}

int config_store_set(const char *key, const char *value)
{
    size_t capacity;
    char path[48];
    char *dst = field(key, &capacity);
    if (!dst || !value) {
        return -EINVAL;
    }
    size_t len = strlen(value);
    if (len >= capacity || (!strcmp(key, "client_id") && !len)) {
        return -EINVAL;
    }
    if (!strcmp(key, "password") && len && (len < 8 || len > 63)) {
        return -EINVAL;
    }
    /* Serialize flash and RAM updates so concurrent writers cannot diverge. */
    k_mutex_lock(&config_lock, K_FOREVER);
    snprintf(path, sizeof(path), "iot/%s", key);
    int err = settings_save_one(path, value, len);
    if (!err) {
        memset(dst, 0, capacity);
        memcpy(dst, value, len);
    }
    k_mutex_unlock(&config_lock);
    return err;
}
```

## src/mqtt_service.c
```c
#include "mqtt_service.h"
#include "wifi_manager.h"
#include <errno.h>
#include <stdio.h>
#include <string.h>
#include <zephyr/kernel.h>
#include <zephyr/logging/log.h>
#include <zephyr/net/mqtt.h>
#include <zephyr/net/socket.h>

LOG_MODULE_REGISTER(mqtt_service);
static struct app_config config;
static struct mqtt_client client;
static struct sockaddr_storage broker;
static uint8_t rx_buffer[1024], tx_buffer[1024];
static bool connected;
static struct k_thread mqtt_thread;
K_THREAD_STACK_DEFINE(mqtt_stack, 6144);

static void mqtt_event(struct mqtt_client *c, const struct mqtt_evt *event)
{
    ARG_UNUSED(c);
    if (event->type == MQTT_EVT_CONNACK) {
        connected = event->result == 0;
    } else if (event->type == MQTT_EVT_DISCONNECT) {
        connected = false;
    }
}

static int connect_broker(void)
{
    struct zsock_addrinfo *result = NULL;
    struct zsock_addrinfo hints = {
        .ai_family = AF_INET, .ai_socktype = SOCK_STREAM
    };
    int err = zsock_getaddrinfo(config.broker, "1883", &hints, &result);
    if (err) {
        return -EHOSTUNREACH;
    }
    if (!result || result->ai_addrlen > sizeof(broker)) {
        if (result) {
            zsock_freeaddrinfo(result);
        }
        return -EINVAL;
    }
    memset(&broker, 0, sizeof(broker));
    memcpy(&broker, result->ai_addr, result->ai_addrlen);
    zsock_freeaddrinfo(result);

    mqtt_client_init(&client);
    client.broker = &broker;
    client.evt_cb = mqtt_event;
    client.client_id.utf8 = (uint8_t *)config.client_id;
    client.client_id.size = strlen(config.client_id);
    client.protocol_version = MQTT_VERSION_3_1_1;
    client.rx_buf = rx_buffer;
    client.rx_buf_size = sizeof(rx_buffer);
    client.tx_buf = tx_buffer;
    client.tx_buf_size = sizeof(tx_buffer);
    client.transport.type = MQTT_TRANSPORT_NON_SECURE;
    return mqtt_connect(&client);
}

static int publish_status(void)
{
    char payload[80];
    char topic[96];
    int len = snprintf(payload, sizeof(payload), "{\"uptime_ms\":%lld}",
                       (long long)k_uptime_get());
    snprintf(topic, sizeof(topic), "devices/%s/status", config.client_id);
    struct mqtt_publish_param msg = {
        .message.topic.qos = MQTT_QOS_0_AT_MOST_ONCE,
        .message.topic.topic.utf8 = (uint8_t *)topic,
        .message.topic.topic.size = strlen(topic),
        .message.payload.data = payload,
        .message.payload.len = len,
    };
    return mqtt_publish(&client, &msg);
}

static void run(void *a, void *b, void *c)
{
    ARG_UNUSED(a); ARG_UNUSED(b); ARG_UNUSED(c);
    for (;;) {
        if (wifi_manager_wait_ready(K_SECONDS(5))) {
            continue;
        }
        connected = false;
        int err = connect_broker();
        if (err) {
            LOG_WRN("MQTT connect failed: %d", err);
            k_sleep(K_SECONDS(5));
            continue;
        }
        struct zsock_pollfd fd = {
            .fd = client.transport.tcp.sock, .events = ZSOCK_POLLIN
        };
        int64_t deadline = k_uptime_get() + 10000;
        int64_t next_publish = 0;
        while (wifi_manager_is_connected()) {
            int polled = zsock_poll(&fd, 1, 1000);
            if (polled < 0 || (fd.revents &
                (ZSOCK_POLLERR | ZSOCK_POLLHUP | ZSOCK_POLLNVAL))) {
                break;
            }
            if (fd.revents & ZSOCK_POLLIN) {
                if (mqtt_input(&client)) {
                    break;
                }
            }
            if (!connected) {
                if (k_uptime_get() >= deadline) {
                    break;
                }
                continue;
            }
            err = mqtt_live(&client);
            if (err && err != -EAGAIN) {
                break;
            }
            if (k_uptime_get() >= next_publish) {
                if (publish_status()) {
                    break;
                }
                next_publish = k_uptime_get() +
                    CONFIG_APP_MQTT_PUBLISH_SECONDS * 1000;
            }
        }
        mqtt_abort(&client);
        connected = false;
        k_sleep(K_SECONDS(5));
    }
}

int mqtt_service_start(const struct app_config *cfg)
{
    if (!cfg || !cfg->broker[0] || !cfg->client_id[0]) {
        return -EINVAL;
    }
    config = *cfg;
    /* This thread exclusively owns the MQTT client and socket. */
    k_thread_create(&mqtt_thread, mqtt_stack, K_THREAD_STACK_SIZEOF(mqtt_stack),
                    run, NULL, NULL, NULL, 7, 0, K_NO_WAIT);
    return 0;
}
```

## src/ota_service.c
```c
#include "ota_service.h"
#include <zephyr/dfu/mcuboot.h>
#include <zephyr/storage/flash_map.h>
#include <zephyr/sys/util.h>
#ifdef CONFIG_MCUMGR_TRANSPORT_UDP
#include <zephyr/mgmt/mcumgr/transport/smp_udp.h>
#endif

/* Fail at build time if the target cannot stage an update and retain settings. */
BUILD_ASSERT(FIXED_PARTITION_EXISTS(slot0_partition), "Missing primary image slot");
BUILD_ASSERT(FIXED_PARTITION_EXISTS(slot1_partition), "Missing secondary image slot");
BUILD_ASSERT(FIXED_PARTITION_EXISTS(storage_partition), "Missing settings partition");

int ota_service_init(void)
{
#ifdef CONFIG_MCUMGR_TRANSPORT_UDP
    return smp_udp_open();
#else
    return 0;
#endif
}

int ota_service_confirm(void)
{
    return boot_is_img_confirmed() ? 0 : boot_write_img_confirmed();
}
```

## src/provisioning.c
```c
#include "config_store.h"
#include "wifi_manager.h"
#include "ota_service.h"
#include <zephyr/shell/shell.h>
#include <zephyr/sys/reboot.h>

static int set_config(const struct shell *sh, size_t argc, char **argv)
{
    ARG_UNUSED(argc);
    int err = config_store_set(argv[1], argv[2]);
    if (err) {
        shell_error(sh, "Setting rejected: %d", err);
    } else {
        shell_print(sh, "Saved. Reboot to apply.");
    }
    return err;
}

static int status(const struct shell *sh, size_t argc, char **argv)
{
    ARG_UNUSED(argc); ARG_UNUSED(argv);
    shell_print(sh, "Wi-Fi state: %d (0=down, 1=connecting, 2=IPv4 ready)",
                wifi_manager_get_state());
    return 0;
}

static int confirm(const struct shell *sh, size_t argc, char **argv)
{
    ARG_UNUSED(argc); ARG_UNUSED(argv);
    int err = ota_service_confirm();
    if (err) {
        shell_error(sh, "Image confirmation failed: %d", err);
    } else {
        shell_print(sh, "Running image confirmed");
    }
    return err;
}

static int reboot_device(const struct shell *sh, size_t argc, char **argv)
{
    ARG_UNUSED(sh); ARG_UNUSED(argc); ARG_UNUSED(argv);
    sys_reboot(SYS_REBOOT_COLD);
    return 0;
}

SHELL_STATIC_SUBCMD_SET_CREATE(iot_commands,
    SHELL_CMD_ARG(set, NULL, "set <ssid|password|broker|client_id> <value>",
                  set_config, 3, 0),
    SHELL_CMD_ARG(status, NULL, "Network status (no secrets)", status, 1, 0),
    SHELL_CMD_ARG(confirm, NULL, "Confirm tested MCUboot image", confirm, 1, 0),
    SHELL_CMD_ARG(reboot, NULL, "Reboot to apply settings", reboot_device, 1, 0),
    SHELL_SUBCMD_SET_END
);
SHELL_CMD_REGISTER(iot, &iot_commands, "IoT provisioning and image lifecycle", NULL);
```

## src/wifi_manager.c
```c
#include "wifi_manager.h"
#include <errno.h>
#include <string.h>
#include <zephyr/logging/log.h>
#include <zephyr/net/net_if.h>
#include <zephyr/net/net_event.h>
#include <zephyr/net/wifi_mgmt.h>
#include <zephyr/net/dhcpv4.h>
#include <zephyr/sys/atomic.h>

LOG_MODULE_REGISTER(wifi_manager);
static struct net_if *iface;
static struct net_mgmt_event_callback wifi_cb, ip_cb;
static struct wifi_connect_req_params params;
static char station_ssid[33], station_password[65];
static atomic_t state;
static atomic_t associated;
static struct k_work_delayable connect_work;
static struct k_work_q wifi_queue;
K_THREAD_STACK_DEFINE(wifi_stack, 3072);
K_SEM_DEFINE(ready, 0, 1);

static void retry(void)
{
    atomic_set(&state, WIFI_MANAGER_DISCONNECTED);
    atomic_clear(&associated);
    k_sem_reset(&ready);
    k_work_reschedule_for_queue(&wifi_queue, &connect_work,
                               K_SECONDS(CONFIG_APP_WIFI_RETRY_SECONDS));
}

static void connect_handler(struct k_work *work)
{
    ARG_UNUSED(work);
    if (wifi_manager_is_connected()) {
        return;
    }
    /* Retry a timed-out association too; bound each request in the driver. */
    atomic_set(&state, WIFI_MANAGER_CONNECTING);
    int err = net_mgmt(NET_REQUEST_WIFI_CONNECT, iface, &params, sizeof(params));
    if (err && err != -EALREADY) {
        LOG_WRN("Connection request failed: %d", err);
        retry();
    }
}

static void wifi_event(struct net_mgmt_event_callback *cb,
                       uint32_t event, struct net_if *event_iface)
{
    if (event_iface != iface) {
        return;
    }
    if (event == NET_EVENT_WIFI_CONNECT_RESULT) {
        const struct wifi_status *result = cb->info;
        if (!result || result->status) {
            LOG_WRN("Wi-Fi association failed");
            retry();
            return;
        }
        atomic_set(&associated, 1);
        net_dhcpv4_start(iface);
    } else if (event == NET_EVENT_WIFI_DISCONNECT_RESULT) {
        net_dhcpv4_stop(iface);
        retry();
    }
}

static void ip_event(struct net_mgmt_event_callback *cb,
                     uint32_t event, struct net_if *event_iface)
{
    ARG_UNUSED(cb);
    if (event_iface != iface) {
        return;
    }
    if (event == NET_EVENT_IPV4_DHCP_BOUND && atomic_get(&associated)) {
        atomic_set(&state, WIFI_MANAGER_CONNECTED);
        k_sem_give(&ready);
        LOG_INF("Wi-Fi IPv4 ready");
    } else if (event == NET_EVENT_IPV4_ADDR_DEL) {
        atomic_set(&state, WIFI_MANAGER_CONNECTING);
        k_sem_reset(&ready);
    }
}

int wifi_manager_init(const char *ssid, const char *password)
{
    if (!ssid || !password || !strlen(ssid) || strlen(ssid) > 32 ||
        (strlen(password) && (strlen(password) < 8 || strlen(password) > 63))) {
        return -EINVAL;
    }
    iface = net_if_get_wifi_sta();
    if (!iface) {
        return -ENODEV;
    }
    strcpy(station_ssid, ssid);
    strcpy(station_password, password);
    params = (struct wifi_connect_req_params) {
        .ssid = (const uint8_t *)station_ssid,
        .ssid_length = strlen(station_ssid),
        .psk = (const uint8_t *)station_password,
        .psk_length = strlen(station_password),
        .channel = WIFI_CHANNEL_ANY,
        .security = strlen(station_password) ? WIFI_SECURITY_TYPE_PSK :
                                              WIFI_SECURITY_TYPE_NONE,
        .mfp = WIFI_MFP_OPTIONAL,
        .timeout = 20,
    };
    k_work_queue_start(&wifi_queue, wifi_stack, K_THREAD_STACK_SIZEOF(wifi_stack),
                       6, NULL);
    k_work_init_delayable(&connect_work, connect_handler);
    net_mgmt_init_event_callback(&wifi_cb, wifi_event,
        NET_EVENT_WIFI_CONNECT_RESULT | NET_EVENT_WIFI_DISCONNECT_RESULT);
    net_mgmt_add_event_callback(&wifi_cb);
    net_mgmt_init_event_callback(&ip_cb, ip_event,
        NET_EVENT_IPV4_DHCP_BOUND | NET_EVENT_IPV4_ADDR_DEL);
    net_mgmt_add_event_callback(&ip_cb);
    k_work_schedule_for_queue(&wifi_queue, &connect_work, K_NO_WAIT);
    return 0;
}

wifi_manager_state_t wifi_manager_get_state(void)
{
    return (wifi_manager_state_t)atomic_get(&state);
}

bool wifi_manager_is_connected(void)
{
    return wifi_manager_get_state() == WIFI_MANAGER_CONNECTED;
}

int wifi_manager_wait_ready(k_timeout_t timeout)
{
    if (wifi_manager_is_connected()) {
        return 0;
    }
    int err = k_sem_take(&ready, timeout);
    return err ? err : (wifi_manager_is_connected() ? 0 : -ENETDOWN);
}
```
